#include <Wire.h>
#include <Adafruit_MLX90614.h>

Adafruit_MLX90614 mlx = Adafruit_MLX90614();
const int buzzer = 7;
float to;
char a[10];
int loop_interval = 1000; 
int SCL_PIN=13;//D0
int SDA_PIN=11; //D1
int RST_PIN=10;//RST
int DC_PIN=9; //DC
const int trigPin = 6;
const int echoPin = 5;
long duration;
int distance;
int x;

 void LED_CLS(void);
 void LED_Set_Pos(unsigned char x,unsigned char y);//Set the coordinate
 void LED_WrDat(unsigned char data);   //Write Data
 void LED_P8x16Str(unsigned char x,unsigned char y,unsigned char ch[]);
 void LED_Fill(unsigned char dat);
 

const unsigned char F8X16[]=
{
  0x00,0x00,0x00,0x00,0x00,0x00,0x00,0x00,0x00,0x00,0x00,0x00,0x00,0x00,0x00,0x00,// 0
  0x00,0x00,0x00,0xF8,0x00,0x00,0x00,0x00,0x00,0x00,0x00,0x33,0x30,0x00,0x00,0x00,//!1
  0x00,0x10,0x0C,0x06,0x10,0x0C,0x06,0x00,0x00,0x00,0x00,0x00,0x00,0x00,0x00,0x00,//"2
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  0xC0,0x30,0xC8,0x28,0xE8,0x10,0xE0,0x00,0x07,0x18,0x27,0x24,0x23,0x14,0x0B,0x00,//@32
  
 
};

void LED_WrCmd(unsigned char cmd) 
{
  unsigned char i = 8;
  //LED_CS = 0;
  //LED_DCL;;;
        digitalWrite(DC_PIN,LOW);;;
  //LED_SCLL;;;
  digitalWrite(SCL_PIN,LOW);;;
         while (i--)
  {
    if (cmd & 0x80)
    {
      //LED_SDAH;;;
                      digitalWrite(SDA_PIN,HIGH);;;
    }
    else
    {
      //LED_SDAL;;;
                      digitalWrite(SDA_PIN,LOW);;;
    }
    //LED_SCLH;;;
    digitalWrite(SCL_PIN,HIGH);;;
                asm("nop");;;           
    //LED_SCLL;;;
                digitalWrite(SCL_PIN,LOW);;;
    cmd <<= 1;   
  }   
  //LED_CS = 1;
}


void LEDPIN_Init(void)    
{
  pinMode(SCL_PIN,OUTPUT);
  pinMode(SDA_PIN,OUTPUT);
  pinMode(RST_PIN,OUTPUT);
  pinMode(DC_PIN,OUTPUT);
}
void LED_WrDat(unsigned char data)   
{
  unsigned char i = 8;
  //LED_CS=0;
  //LED_DCH;;;
        digitalWrite(DC_PIN,HIGH);
  //LED_SCLL;;; 
        digitalWrite(SCL_PIN,LOW);
  while (i--)
  {
    if (data & 0x80)
    {
      digitalWrite(SDA_PIN,HIGH);;;;
    }
    else
    {
      digitalWrite(SDA_PIN,LOW);;;
    }
    //LED_SCLH;;; 
                digitalWrite(SCL_PIN,HIGH);;;
    asm("nop");;;     
    //LED_SCLL;;;
                digitalWrite(SCL_PIN,LOW);
    data <<= 1;    
  }
  //LED_CS=1;
}



void LED_Set_Pos(unsigned char x, unsigned char y)
{ 
  LED_WrCmd(0xb0+y);
  LED_WrCmd(((x&0xf0)>>4)|0x10);
  LED_WrCmd((x&0x0f)|0x00); 
} 


void LED_Fill(unsigned char bmp_data)
{
  unsigned char y,x;
  
  for(y=0;y<8;y++)
  {
    LED_WrCmd(0xb0+y);  
    LED_WrCmd(0x00);     
    LED_WrCmd(0x10);       
    for(x=0;x<128;x++)
      LED_WrDat(bmp_data);
  }
} 



void LED_CLS(void) 
{
  unsigned char y,x;  
  for(y=0;y<8;y++)
  {
    LED_WrCmd(0xb0+y);
    LED_WrCmd(0x00);
    LED_WrCmd(0x10); 
    for(x=0;x<128;x++)
      LED_WrDat(0);
  }
}

void LED_DLY_ms(unsigned int ms)
{                         
  unsigned int a;
  while(ms)
  {
    a=6675;
    while(a--);
    ms--;
  }
  return;
//  time_delay_ms(ms);
}

void SetStartColumn(unsigned char d)
{
  LED_WrCmd(0x00+d%16); // Set Lower Column Start Address for Page Addressing Mode
              // Default => 0x00
  LED_WrCmd(0x10+d/16); // Set Higher Column Start Address for Page Addressing Mode
              // Default => 0x10
}

void SetAddressingMode(unsigned char d)
{
  LED_WrCmd(0x20);      // Set Memory Addressing Mode
  LED_WrCmd(d);     // Default => 0x02
              // 0x00 => Horizontal Addressing Mode
              // 0x01 => Vertical Addressing Mode
              // 0x02 => Page Addressing Mode
}

void SetColumnAddress(unsigned char a, unsigned char b)
{
  LED_WrCmd(0x21);      // Set Column Address
  LED_WrCmd(a);     // Default => 0x00 (Column Start Address)
  LED_WrCmd(b);     // Default => 0x7F (Column End Address)
}

void SetPageAddress(unsigned char a, unsigned char b)
{
  LED_WrCmd(0x22);      // Set Page Address
  LED_WrCmd(a);     // Default => 0x00 (Page Start Address)
  LED_WrCmd(b);     // Default => 0x07 (Page End Address)
}

void SetStartLine(unsigned char d)
{
  LED_WrCmd(0x40|d);    // Set Display Start Line
              // Default => 0x40 (0x00)
}

void SetContrastControl(unsigned char d)
{
  LED_WrCmd(0x81);      // Set Contrast Control
  LED_WrCmd(d);     // Default => 0x7F
}

void Set_Charge_Pump(unsigned char d)
{
  LED_WrCmd(0x8D);      // Set Charge Pump
  LED_WrCmd(0x10|d);    // Default => 0x10
              // 0x10 (0x00) => Disable Charge Pump
              // 0x14 (0x04) => Enable Charge Pump
}

void Set_Segment_Remap(unsigned char d)
{
  LED_WrCmd(0xA0|d);    // Set Segment Re-Map
              // Default => 0xA0
              // 0xA0 (0x00) => Column Address 0 Mapped to SEG0
              // 0xA1 (0x01) => Column Address 0 Mapped to SEG127
}

void Set_Entire_Display(unsigned char d)
{
  LED_WrCmd(0xA4|d);    // Set Entire Display On / Off
              // Default => 0xA4
              // 0xA4 (0x00) => Normal Display
              // 0xA5 (0x01) => Entire Display On
}

void Set_Inverse_Display(unsigned char d)
{
  LED_WrCmd(0xA6|d);    // Set Inverse Display On/Off
              // Default => 0xA6
              // 0xA6 (0x00) => Normal Display
              // 0xA7 (0x01) => Inverse Display On
}

void Set_Multiplex_Ratio(unsigned char d)
{
  LED_WrCmd(0xA8);      // Set Multiplex Ratio
  LED_WrCmd(d);     // Default => 0x3F (1/64 Duty)
}

void Set_Display_On_Off(unsigned char d)
{
  LED_WrCmd(0xAE|d);    // Set Display On/Off
              // Default => 0xAE
              // 0xAE (0x00) => Display Off
              // 0xAF (0x01) => Display On
}

void SetStartPage(unsigned char d)
{
  LED_WrCmd(0xB0|d);    // Set Page Start Address for Page Addressing Mode
              // Default => 0xB0 (0x00)
}

void Set_Common_Remap(unsigned char d)
{
  LED_WrCmd(0xC0|d);    // Set COM Output Scan Direction
              // Default => 0xC0
              // 0xC0 (0x00) => Scan from COM0 to 63
              // 0xC8 (0x08) => Scan from COM63 to 0
}

void Set_Display_Offset(unsigned char d)
{
  LED_WrCmd(0xD3);      // Set Display Offset
  LED_WrCmd(d);     // Default => 0x00
}

void Set_Display_Clock(unsigned char d)
{
  LED_WrCmd(0xD5);      // Set Display Clock Divide Ratio / Oscillator Frequency
  LED_WrCmd(d);     // Default => 0x80
              // D[3:0] => Display Clock Divider
              // D[7:4] => Oscillator Frequency
}

void Set_Precharge_Period(unsigned char d)
{
  LED_WrCmd(0xD9);      // Set Pre-Charge Period
  LED_WrCmd(d);     // Default => 0x22 (2 Display Clocks [Phase 2] / 2 Display Clocks [Phase 1])
              // D[3:0] => Phase 1 Period in 1~15 Display Clocks
              // D[7:4] => Phase 2 Period in 1~15 Display Clocks
}

void Set_Common_Config(unsigned char d)
{
  LED_WrCmd(0xDA);      // Set COM Pins Hardware Configuration
  LED_WrCmd(0x02|d);    // Default => 0x12 (0x10)
              // Alternative COM Pin Configuration
              // Disable COM Left/Right Re-Map
}

void Set_VCOMH(unsigned char d)
{
  LED_WrCmd(0xDB);      // Set VCOMH Deselect Level
  LED_WrCmd(d);     // Default => 0x20 (0.77*VCC)
}

void Set_NOP(void)
{
  LED_WrCmd(0xE3);      // Command for No Operation
}
void LED_Init(void)        
{
  unsigned char i;
        LEDPIN_Init();
//  LED_PORT=0X0F;
  //LED_SCLH;;;   
  //LED_RSTL;;;
        digitalWrite(SCL_PIN,HIGH);;;
        digitalWrite(RST_PIN,LOW);;;
//  for(i=0;i<100;i++)asm("nop");       
        LED_DLY_ms(50);
  //LED_RSTH;;;
        digitalWrite(RST_PIN,HIGH);
  Set_Display_On_Off(0x00);     // Display Off (0x00/0x01)
  Set_Display_Clock(0x80);      // Set Clock as 100 Frames/Sec
  Set_Multiplex_Ratio(0x3F);    // 1/64 Duty (0x0F~0x3F)
  Set_Display_Offset(0x00);     // Shift Mapping RAM Counter (0x00~0x3F)
  SetStartLine(0x00);       // Set Mapping RAM Display Start Line (0x00~0x3F)
  Set_Charge_Pump(0x04);      // Enable Embedded DC/DC Converter (0x00/0x04)
  SetAddressingMode(0x02);    // Set Page Addressing Mode (0x00/0x01/0x02)
  Set_Segment_Remap(0x01);    // Set SEG/Column Mapping  
  Set_Common_Remap(0x08);   // Set COM/Row Scan Direction 
  Set_Common_Config(0x10);    // Set Sequential Configuration (0x00/0x10)
  SetContrastControl(0xCF); // Set SEG Output Current
  Set_Precharge_Period(0xF1);   // Set Pre-Charge as 15 Clocks & Discharge as 1 Clock
  Set_VCOMH(0x40);        // Set VCOM Deselect Level
  Set_Entire_Display(0x00);     // Disable Entire Display On (0x00/0x01)
  Set_Inverse_Display(0x00);    // Disable Inverse Display On (0x00/0x01)  
  Set_Display_On_Off(0x01);     // Display On (0x00/0x01)
  LED_Fill(0x00);                               //clear all
  LED_Set_Pos(0,0);   
} 
 


void LED_P8x16Str(unsigned char x,unsigned char y,char ch[])
{
  unsigned char c=0,i=0,j=0;
  while (ch[j]!='\0')
  {    
    c =ch[j]-32;
    if(x>120)
    {
      x=0;
      y++;
    }
    LED_Set_Pos(x,y);    
    for(i=0;i<8;i++) 
    {
      LED_WrDat(F8X16[(c<<4)+i]);
    }
    LED_Set_Pos(x,y+1);    
    for(i=0;i<8;i++) 
    {
      LED_WrDat(F8X16[(c<<4)+i+8]);
    }
    x+=8;
    j++;
  }
}

 void setup()
 {

 pinMode(buzzer, OUTPUT);
pinMode(trigPin, OUTPUT); 
pinMode(echoPin, INPUT);
  mlx.begin();  // enable the MLX90614 reading
  Serial.begin(115200);
  delay(1000);
   LEDPIN_Init();
   LED_Init();
  

 }
 void loop()
 {
x = ultraSonic ();
if (x>=9 && x<=12)
{
to = 8 + mlx.readObjectTempC();
dtostrf(to,7, 2, a);
LED_P8x16Str(30,3, a);
delay(1000);
 }
 else if (x>12 || x<9)
  { to=0;
 dtostrf(to,7, 2, a);
LED_P8x16Str(30,3, a);

 }
if (to>=39)
{
tone(buzzer, 1000);
delay(1000);
noTone(buzzer);
 }
 
 }
int ultraSonic ()
 {digitalWrite(trigPin, LOW);
delayMicroseconds(2);
digitalWrite(trigPin, HIGH);
delayMicroseconds(10);
digitalWrite(trigPin, LOW);
duration = pulseIn(echoPin, HIGH);
distance= duration*0.034/2;
Serial.println(distance);
return distance;
}
